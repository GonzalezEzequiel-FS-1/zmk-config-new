/ {
    compatible = "zmk,keyboard";

    matrix {
        rows = <6>;
        cols = <4>;
        diode-direction = "col2row";

        row-gpios = <&gpio0 6 GPIO_ACTIVE_LOW>,
                    <&gpio0 8 GPIO_ACTIVE_LOW>,
                    <&gpio0 22 GPIO_ACTIVE_LOW>,
                    <&gpio0 9 GPIO_ACTIVE_LOW>,
                    <&gpio0 20 GPIO_ACTIVE_LOW>,
                    <&gpio0 24 GPIO_ACTIVE_LOW>;

        col-gpios = <&gpio0 10 GPIO_ACTIVE_LOW>,
                    <&gpio0 31 GPIO_ACTIVE_LOW>,
                    <&gpio0 29 GPIO_ACTIVE_LOW>,
                    <&gpio0 2 GPIO_ACTIVE_LOW>;
    };
};
